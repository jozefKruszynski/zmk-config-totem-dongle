## config/boards/shields/totem/Kconfig.shield
```kconfig
# Copyright (c) 2023 The ZMK Contributors
# SPDX-License-Identifier: MIT
config SHIELD_TOTEM_DONGLE
    bool

config SHIELD_TOTEM_DONGLE
	def_bool $(shields_list_contains,totem_dongle)
	select ZMK_SPLIT_ROLE_CENTRAL
    select ZMK_SPLIT
	select SHIELD_TOTEM

config SHIELD_TOTEM_LEFT
	def_bool $(shields_list_contains,totem_left)
	select ZMK_SPLIT
	select SHIELD_TOTEM

config SHIELD_TOTEM_RIGHT
	def_bool $(shields_list_contains,totem_right)
	select ZMK_SPLIT
	select SHIELD_TOTEM
```
